## br2-external/configs/hvac_qemu_aarch64_defconfig
```kconfig
BR2_aarch64=y
BR2_TOOLCHAIN_EXTERNAL=y
BR2_TOOLCHAIN_EXTERNAL_BOOTLIN=y
BR2_TOOLCHAIN_EXTERNAL_BOOTLIN_AARCH64_GLIBC_STABLE=y
BR2_CCACHE=y
BR2_CCACHE_DIR="$(BR2_EXTERNAL_HVAC_PATH)/../.cache/ccache"
BR2_GLOBAL_PATCH_DIR="board/qemu/patches"
BR2_DOWNLOAD_FORCE_CHECK_HASHES=y
BR2_TARGET_GENERIC_HOSTNAME="hvac"
BR2_TARGET_GENERIC_ISSUE="HVAC QEMU board"
BR2_SYSTEM_DHCP="eth0"
BR2_ROOTFS_OVERLAY="$(BR2_EXTERNAL_HVAC_PATH)/board/hvac-qemu/rootfs-overlay"
BR2_ROOTFS_POST_BUILD_SCRIPT="$(BR2_EXTERNAL_HVAC_PATH)/board/hvac-qemu/post-build.sh"
BR2_LINUX_KERNEL=y
BR2_LINUX_KERNEL_CUSTOM_VERSION=y
BR2_LINUX_KERNEL_CUSTOM_VERSION_VALUE="6.18.7"
BR2_LINUX_KERNEL_USE_CUSTOM_CONFIG=y
BR2_LINUX_KERNEL_CUSTOM_CONFIG_FILE="board/qemu/aarch64-virt/linux.config"
BR2_LINUX_KERNEL_CONFIG_FRAGMENT_FILES="$(BR2_EXTERNAL_HVAC_PATH)/board/hvac-qemu/linux.fragment"
BR2_LINUX_KERNEL_NEEDS_HOST_OPENSSL=y
BR2_PACKAGE_I2C_TOOLS=y
BR2_PACKAGE_PYTHON3=y
BR2_PACKAGE_PYTHON3_PYEXPAT=y
BR2_PACKAGE_PYTHON3_ZLIB=y
BR2_PACKAGE_PYTHON_PYTEST=y
BR2_PACKAGE_LIBMODBUS=y
BR2_PACKAGE_MOSQUITTO=y
BR2_PACKAGE_MOSQUITTO_BROKER=y
BR2_PACKAGE_HVAC_TEMP=y
BR2_PACKAGE_HVAC_HELLO=y
BR2_PACKAGE_HVACD=y
BR2_TARGET_ROOTFS_EXT2=y
BR2_TARGET_ROOTFS_EXT2_4=y
BR2_TARGET_ROOTFS_EXT2_SIZE="768M"
# BR2_TARGET_ROOTFS_TAR is not set
```

## br2-external/package/hvac-hello/Config.in
```kconfig
config BR2_PACKAGE_HVAC_HELLO
	bool "hvac-hello"
	depends on BR2_LINUX_KERNEL
	help
	  Minimal "hello" kernel module used to learn how modules
	  load and unload (examples/hello_module/).

comment "hvac-hello needs a Linux kernel to be built"
	depends on !BR2_LINUX_KERNEL
```

## br2-external/package/hvac-temp/Config.in
```kconfig
config BR2_PACKAGE_HVAC_TEMP
	bool "hvac-temp"
	depends on BR2_LINUX_KERNEL
	help
	  hvac_temp: Linux IIO driver for a TMP102-compatible I2C
	  temperature sensor (this project's driver/ folder).

comment "hvac-temp needs a Linux kernel to be built"
	depends on !BR2_LINUX_KERNEL
```

## br2-external/package/hvacd/Config.in
```kconfig
config BR2_PACKAGE_HVACD
	bool "hvacd"
	select BR2_PACKAGE_LIBMODBUS
	select BR2_PACKAGE_MOSQUITTO
	help
	  hvacd: thermostat daemon (this project's thermostat/ folder).
	  Reads the hvac_temp IIO sensor, runs the control core and
	  serves a Modbus TCP register map; optional MQTT telemetry
	  (libmosquitto).
```
